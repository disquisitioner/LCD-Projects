
/*
 * Software SPI to match my use of the Sparkfun Nokia 5110 LCD
 * https://learn.sparkfun.com/tutorials/graphic-lcd-hookup-guide
 * Software SPI is slower but gives you much more flexibility in
 * selecting pins to use.
 *
 * Note that the Sparkfun version of the 5110 has a different pinout
 * than the Adafruit one, but both use the same PCD8544 controller
 * so are fully compatible otherwise.
 *
 * Author: David Bryant (david@orangemoose.com)
 */
 
#include <SPI.h>
#include <Adafruit_GFX.h>
#include <Adafruit_PCD8544.h>

#define LCD_CLK 10    // Serial clock out (SCLK)
#define LCD_MOSI 9    // Serial data out to LCD (DN/MOSI)
#define LCD_DC 11     // Data/Command select (D/C)
#define LCD_CS 12     // LCD chip select (CS or SCE)
#define LCD_RESET 13  // LCD reset (RST)
Adafruit_PCD8544 display(LCD_CLK, LCD_MOSI, LCD_DC, LCD_CS, LCD_RESET);

#define BL_PIN 6  // Backlight control pin

#define LOGO_WIDTH  64
#define LOGO_HEIGHT 48
#define LCD_WIDTH   84   // Needs to be >= LOGO_WIDTH
#define LCD_HEIGHT  48   // Needs to be >= LOGO_HEIGHT

static const unsigned char PROGMEM orangemoose[(LOGO_WIDTH * LOGO_HEIGHT)/8] = {
0x00, 0x00, 0x00, 0x00, 0x00, 0x00, 0x00, 0x00,  /* 1 */
0x00, 0x00, 0x00, 0x00, 0x00, 0x00, 0x00, 0x00,  
0x00, 0x00, 0x00, 0x00, 0x00, 0x00, 0x00, 0x00,
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0x00, 0x00, 0x00, 0x00, 0x00, 0x00, 0x00, 0x00,  /* 48 */
};
 
void setup()
{ 
  display.begin();          // Initialize the display
  display.setContrast(50);  // Set contrast, 50 works well
  analogWrite(BL_PIN,250);  // Turn backlight LEDs on (bright!)

  // Clear the display buffer before enabling it so it
  // doesn't show the splashscreen built into the Adafruit
  // library (Adafruit logo)
  display.clearDisplay(); 
 
  // draw our logo bitmap, centered
  display.drawBitmap((LCD_WIDTH - LOGO_WIDTH)/2,(LCD_HEIGHT - LOGO_HEIGHT)/2,
    orangemoose,LOGO_WIDTH,LOGO_HEIGHT,BLACK);
  display.display();   // Now enable & show the display
  
  randomSeed(analogRead(A0));   // Randomize
}


void loop()
{ 
  // Fade the backlight LEDs on and off...
  for (int j=0; j<2; j++)
  {
    for (int i=255; i>=0; i-=5)
    {
      analogWrite(BL_PIN, i); // blPin is ocnnected to BL LED
      delay(40);
    }
    for (int i=0; i<256; i+=5)
    {
      analogWrite(BL_PIN, i);
      delay(40);
    }
  }
  // Now move the bitmap around (as much as possible)
  display.clearDisplay();
  display.drawBitmap(random(0,(LCD_WIDTH-LOGO_WIDTH)), random(0,(LCD_HEIGHT-LOGO_HEIGHT)),
    orangemoose,LOGO_WIDTH,LOGO_HEIGHT, BLACK);
  display.display();
}
